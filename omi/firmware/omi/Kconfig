## omi/firmware/omi/Kconfig
```kconfig
source "Kconfig.zephyr"

menu "Omi Features Configuration"

config OMI_CODEC_OPUS
    bool "Opus Audio Codec"
    help
        "Enable the Opus audio codec support."
    default n

config OMI_ENABLE_OFFLINE_STORAGE
	bool "Offline SD Card Storage"
    help
        "Enable the offline storage support. Requires a SD Card."
	default n

config OMI_ENABLE_ACCELEROMETER
    bool "Accelerometer Support"
    help
        "Enable the accelerometer support."
    default n

config OMI_ENABLE_BUTTON
    bool "Button support"
    help
        "Enable the software button support."
    default n

config OMI_ENABLE_SPEAKER
    bool "Enable the speaker"
    help
        "Enable the speaker support."
    default n

config OMI_ENABLE_BATTERY
    bool "Enable the battery"
    help
        "Enable the battery support."
    default n

config OMI_ENABLE_USB
    bool "Enable the usb"
    help
        "Enable the USB power check support."
    default n

config OMI_ENABLE_HAPTIC
    bool "Enable the haptic"
    help
        "Enable the haptic support."
    default n

config OMI_ENABLE_RFSW_CTRL
    bool "Enable RFSwitch Control"
    help
        "Enable RFSwitch Control support."
    default y

config OMI_ENABLE_MONITOR
    bool "Enable monitoring/metrics system"
    help
        "Enable the monitoring system for debugging and metrics collection.
         Disable in production to save power, RAM, and flash space."
    default n

config OMI_ENABLE_T5838_AAD
    bool "Enable T5838 hardware AAD (ultra-low-power mic sleep)"
    default n
    help
        "After the configured silence interval, pause the PDM clock so the
         T5838 MEMS microphone enters its built-in Acoustic Activity Detection
         mode (~15 µA). The mic hardware monitors sound and asserts the WAKE
         pin when it detects acoustic activity, at which point the driver
         resumes PDM and audio streaming.
         Requires THSEL (P1.5) and WAKE (P1.2) to be wired to the T5838."

config OMI_VAD_ABS_THRESHOLD
    int "AAD silence-detection average absolute amplitude threshold"
    range 1 32767
    default 600
    depends on OMI_ENABLE_T5838_AAD
    help
        "Average absolute amplitude of a 100 ms block after the speech-band filter
         (250 Hz high-pass, 3.4 kHz low-pass). Enough such blocks (see
         OMI_VAD_SUSTAIN_BLOCKS) reset the silence timer that decides when to enter
         T5838 hardware AAD sleep. This does not gate streamed audio."

config OMI_VAD_SUSTAIN_BLOCKS
    int "Speech-band blocks needed in the recent window to count as sound"
    range 1 8
    default 3
    depends on OMI_ENABLE_T5838_AAD
    help
        "At least this many of the last OMI_VAD_WINDOW_BLOCKS 100 ms blocks must reach
         OMI_VAD_ABS_THRESHOLD before the silence timer resets, so isolated clicks such
         as keystrokes do not keep the microphone awake."

config OMI_VAD_WINDOW_BLOCKS
    int "Recent 100 ms blocks considered by the VOX sustain rule"
    range 1 8
    default 5
    depends on OMI_ENABLE_T5838_AAD

config OMI_VAD_HOLD_MS
    int "AAD silence hold time before hardware sleep (ms)"
    range 500 30000
    default 3000
    depends on OMI_ENABLE_T5838_AAD
    help
        "Amount of continuous below-threshold silence before entering T5838
         hardware AAD sleep and emitting an explicit recording-end marker.
         Trailing silence stays in the recording; sound restarts recording."

config OMI_AAD_SETTLE_MS
    int "T5838 AAD settle time before arming WAKE (ms)"
    range 100 3000
    default 800
    depends on OMI_ENABLE_T5838_AAD
    help
        "Time to wait after clocking the T5838 into hardware AAD sleep before
         arming the WAKE interrupt. Lets the mic settle its noise floor and
         swallow the entry transient so it does not immediately false-wake."

config OMI_AAD_WAKE_HAPTIC_MIN_SLEEP_MS
    int "Minimum AAD sleep before a sound wake vibrates (ms)"
    range 0 86400000
    default 300000
    depends on OMI_ENABLE_T5838_AAD
    help
        "A sound wake vibrates only when the mic was in hardware AAD sleep for
         at least this long. Shorter wake/sleep cycles resume silently."

config OMI_MIC_START_DISCARD_MS
    int "Audio discarded after the mic restarts (ms)"
    range 0 2000
    default 500
    depends on OMI_ENABLE_T5838_AAD
    help
        "After an acoustic wake or manual resume, drop this much PCM (rounded up
         to 100 ms blocks) before recording and VOX tracking. Covers the PDM
         startup transient and the wake vibration."

config OMI_WIFI_UPLOAD
    bool "Upload recordings over Wi-Fi to one local receiver while charging"
    depends on OMI_ENABLE_OFFLINE_STORAGE && WIFI_NRF70 && NET_SOCKETS && NET_TCP && NET_DHCPV4
    default n
    help
        "Local-only recorder: when the device is on the charger and the ring
         holds unread audio, join the provisioned Wi-Fi network, authenticate
         the provisioned receiver (omi-local serve) with a shared secret and
         stream the recordings to it. Records are deleted only after the
         receiver acknowledges it persisted them. Build with
         overlay-wifi-upload.conf + sysbuild-wifi.conf."

config OMI_WATCHDOG_TIMEOUT_MS
    int "Watchdog timeout (ms)"
    range 5000 300000
    default 30000
    help
        "Watchdog reset timeout in milliseconds. Increase this when boot-time
         operations can run longer (e.g. SD/LFS pre-warm) to avoid false
         watchdog resets."

endmenu
```
